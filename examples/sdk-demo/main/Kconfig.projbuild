## examples/sdk-demo/main/Kconfig.projbuild
```kconfig
menu "Welink Configuration"

config WELINK_WiFi_SSID
    string "WiFi SSID"
    default "HUAWEI001"
    help
        wifi ssid

config WELINK_WiFi_PASSWORD
    string "WiFi PASSWORD"
    default "espressif"
    help
        wifi password

config WELINK_PID
    int "pid"
    default 1700005325
    help
        You need to the official website of Welink to get this parameter

config WELINK_SN
    string "welink sn"
    default "FE2722F7B161494c"
    help
        You need to the official website of Welink to get this parameter

config WELINK_LICENSE
    string "welink license"
    default "304502206D4A274CBF6BC2F43A2FAAD57BF98A153F3F1EE47EEE1AE171D5A3ED8C7C1260022100E61FFB7ADD86E2C1821CD38566A93A0395D70E6A5796FDD544133D80CBE3E9F4"
    help
        You need to the official website of Welink to get this parameter

endmenu
```

## examples/sdk-demo/sdkconfig.defaults
```kconfig
#
# Welink Configuration
#
CONFIG_WELINK_WiFi_SSID="xwx"
CONFIG_WELINK_WiFi_PASSWORD="12345678"
CONFIG_WELINK_PID=1700005325
CONFIG_WELINK_SN="FE2722F7B161494c"
CONFIG_WELINK_LICENSE="304502206D4A274CBF6BC2F43A2FAAD57BF98A153F3F1EE47EEE1AE171D5A3ED8C7C1260022100E61FFB7ADD86E2C1821CD38566A93A0395D70E6A5796FDD544133D80CBE3E9F4"

#
# Partition Table
#
CONFIG_PARTITION_TABLE_SINGLE_APP=
CONFIG_PARTITION_TABLE_TWO_OTA=y
CONFIG_PARTITION_TABLE_CUSTOM=
CONFIG_PARTITION_TABLE_CUSTOM_FILENAME="partitions.csv"
CONFIG_PARTITION_TABLE_CUSTOM_APP_BIN_OFFSET=0x10000
CONFIG_PARTITION_TABLE_OFFSET=0x8000
CONFIG_PARTITION_TABLE_FILENAME="partitions_two_ota.csv"
CONFIG_APP_OFFSET=0x10000

#
# Serial flasher config
#
CONFIG_ESPTOOLPY_FLASHSIZE_4MB=y

#
# LWIP RAW API
#
CONFIG_LWIP_IPV6=y

#
# FreeRTOS
#
CONFIG_FREERTOS_UNICORE=y
CONFIG_FREERTOS_CORETIMER_0=y
```
